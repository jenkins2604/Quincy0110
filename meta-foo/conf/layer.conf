## meta-foo/conf/layer.conf
```bitbake
# We have a conf and classes directory, add to BBPATH
BBPATH .= ":${LAYERDIR}"

# We have recipes-* directories, add to BBFILES
BBFILES += "${LAYERDIR}/recipes-*/*/*.bb \
            ${LAYERDIR}/recipes-*/*/*.bbappend"

BBFILE_COLLECTIONS += "meta-foo"
BBFILE_PATTERN_meta-foo = "^${LAYERDIR}/"
BBFILE_PRIORITY_meta-foo = "6"

LAYERDEPENDS_meta-foo = "core"
LAYERSERIES_COMPAT_meta-foo = "dunfell"
```
